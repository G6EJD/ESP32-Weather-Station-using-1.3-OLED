#include "SH1106Wire.h"    // https://github.com/ThingPulse/esp8266-oled-ssd1306
#include "OLEDDisplayUi.h" // Part of SSD1306/SH1106

#include <WiFi.h>
#include <ArduinoJson.h>   // https://github.com/bblanchon/ArduinoJson - latest version
#include "time.h"
#define icon_width    40
#define icon_height   40
#define display_width 128

// Define each of the *icons for display
const uint8_t snow_icon[] PROGMEM = {
  0x00, 0x00, 0x00, 0x00, 0x00, 0x00, 0x00, 0x00, 0x00, 0x00, 0x00, 0x00, 
  0x00, 0x00, 0x00, 0x00, 0x00, 0x00, 0x00, 0x00, 0x00, 0x30, 0x00, 0x00, 
  0x00, 0x00, 0x30, 0x00, 0x00, 0x00, 0x00, 0xFE, 0x01, 0x00, 0x00, 0x00, 
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  0x00, 0x00, 0x00, 0x00, 0x00, 0x00, 0x00, 0x00, };

const uint8_t rain_icon[] PROGMEM = {
  0x00, 0x00, 0x00, 0x00, 0x00, 0x00, 0x00, 0x00, 0x00, 0x00, 0x00, 0x00, 
  0x00, 0x00, 0x00, 0x00, 0x00, 0x00, 0x00, 0x00, 0x00, 0xC0, 0x0F, 0x00, 
  0x00, 0x00, 0xF0, 0x3F, 0x00, 0x00, 0x00, 0x78, 0x7A, 0x00, 0x00, 0x00, 
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  0x00, 0x00, 0x00, 0x00, 0x00, 0x00, 0x00, 0x00, };

const uint8_t sleet_icon[] PROGMEM = {
  0x00, 0x00, 0x00, 0x00, 0x00, 0x00, 0x00, 0x00, 0x00, 0x00, 0x00, 0x00, 
  0x00, 0x00, 0x00, 0x00, 0x00, 0x00, 0x00, 0x00, 0x00, 0x00, 0x00, 0x00, 
  0x00, 0x00, 0x80, 0x01, 0x00, 0x00, 0x00, 0xE0, 0x3F, 0x00, 0x00, 0x00, 
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  0x00, 0x00, 0x00, 0x00, 0x00, 0x00, 0x00, 0x00, };

const uint8_t sunny_icon[] PROGMEM = {
  0x00, 0x00, 0x00, 0x00, 0x00, 0x00, 0x00, 0x00, 0x00, 0x00, 0x00, 0x00, 
  0x00, 0x00, 0x00, 0x00, 0x00, 0x08, 0x00, 0x00, 0x00, 0xC0, 0x1C, 0x01, 
  0x00, 0x00, 0xC0, 0xDC, 0x01, 0x00, 0x00, 0xC6, 0xFF, 0x33, 0x00, 0x00, 
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  0x00, 0x00, 0x00, 0x00, 0x00, 0x00, 0x00, 0x00, };

const uint8_t cloudy_icon[] PROGMEM = {
  0x00, 0x00, 0x00, 0x00, 0x00, 0x00, 0x00, 0x00, 0x00, 0x00, 0x00, 0x00, 
  0x00, 0x00, 0x00, 0x00, 0x00, 0x00, 0x00, 0x00, 0x00, 0x00, 0x00, 0x00, 
  0x00, 0x00, 0x00, 0x00, 0x00, 0x00, 0x00, 0x00, 0x00, 0x00, 0x00, 0x00, 
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  0x00, 0x00, 0x00, 0x00, 0x00, 0x00, 0x00, 0x00, };

const uint8_t mostlysunny_icon[] PROGMEM = {
  0x00, 0x00, 0x00, 0x00, 0x00, 0x00, 0x00, 0x00, 0x00, 0x00, 0x00, 0x00, 
  0x00, 0x00, 0x00, 0x00, 0x00, 0x00, 0x00, 0x00, 0x00, 0x00, 0x00, 0x00, 
  0x00, 0x00, 0x00, 0x00, 0x00, 0x00, 0x00, 0x00, 0x00, 0x00, 0x00, 0x00, 
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  0x00, 0x00, 0x00, 0x00, 0x00, 0x00, 0x00, 0x00, };

const uint8_t fog_icon[] PROGMEM = {
  0x00, 0x00, 0x00, 0x00, 0x00, 0x00, 0x00, 0x00, 0x00, 0x00, 0x00, 0x00, 
  0x00, 0x00, 0x00, 0x00, 0x00, 0x00, 0x00, 0x00, 0x00, 0x00, 0x00, 0x00, 
  0x00, 0x00, 0x00, 0x00, 0x00, 0x00, 0x00, 0x00, 0x00, 0x00, 0x00, 0x00, 
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  0x00, 0x00, 0x00, 0x00, 0x00, 0x00, 0x00, 0x00, };

const uint8_t tstorms_icon[] PROGMEM = {
  0x00, 0x00, 0x00, 0x00, 0x00, 0x00, 0x00, 0x00, 0x00, 0x00, 0x00, 0x80, 
  0x07, 0x00, 0x00, 0x00, 0xE0, 0x1F, 0x00, 0x00, 0x00, 0xF0, 0x7E, 0x00, 
  0x00, 0x00, 0x18, 0x68, 0x02, 0x00, 0x00, 0x1C, 0xE0, 0x3F, 0x00, 0x00, 
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  0x00, 0x00, 0x00, 0x00, 0x00, 0x00, 0x00, 0x00, };

const uint8_t nt_mostlycloudy_icon[] PROGMEM = {
  0x00, 0x00, 0x00, 0x00, 0x00, 0x00, 0x00, 0x00, 0x00, 0x00, 0x00, 0x00, 
  0x00, 0x00, 0x00, 0x00, 0x00, 0x00, 0x00, 0x00, 0x00, 0x00, 0x00, 0x00, 
  0x00, 0x00, 0x00, 0x00, 0x00, 0x00, 0x00, 0x00, 0x00, 0x00, 0x00, 0x00, 
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  0x00, 0x00, 0x00, 0x00, 0x00, 0x00, 0x00, 0x00, };

const uint8_t nt_clear_icon[] PROGMEM = {
  0x00, 0x00, 0x00, 0x00, 0x00, 0x00, 0x00, 0x00, 0x00, 0x00, 0x00, 0x00, 
  0x00, 0x00, 0x00, 0x00, 0x00, 0x00, 0x00, 0x00, 0x00, 0x00, 0x00, 0x00, 
  0x00, 0x00, 0x00, 0x08, 0x00, 0x00, 0x00, 0xC0, 0xFF, 0x01, 0x00, 0x00, 
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  0x00, 0x00, 0x00, 0x00, 0x00, 0x00, 0x00, 0x00, };


// Choose and set your Timezone
const char* Timezone    = "GMT0BST,M3.5.0/01,M10.5.0/02";  // Choose your time zone from: https://github.com/nayarsystems/posix_tz_db/blob/master/zones.csv 
int   gmtOffset_sec     = 0;    // UK normal time is GMT, so GMT Offset is 0, for US (-5Hrs) is typically -18000, AU is typically (+8hrs) 28800
int  daylightOffset_sec = 3600; // In the UK DST is +1hr or 3600-secs, other countries may use 2hrs 7200 or 30-mins 1800 or 5.5hrs 19800 Ahead of GMT use + offset behind - offset
// Example time zones
//const char* Timezone = "MET-1METDST,M3.5.0/01,M10.5.0/02"; // Most of Europe
//const char* Timezone = "CET-1CEST,M3.5.0,M10.5.0/3";       // Central Europe
//const char* Timezone = "EST-2METDST,M3.5.0/01,M10.5.0/02"; // Most of Europe
//const char* Timezone = "EST5EDT,M3.2.0,M11.1.0";           // EST USA  
//const char* Timezone = "CST6CDT,M3.2.0,M11.1.0";           // CST USA
//const char* Timezone = "MST7MDT,M4.1.0,M10.5.0";           // MST USA
//const char* Timezone = "NZST-12NZDT,M9.5.0,M4.1.0/3";      // Auckland
//const char* Timezone = "EET-2EEST,M3.5.5/0,M10.5.5/0";     // Asia
//const char* Timezone = "ACST-9:30ACDT,M10.1.0,M4.1.0/3":   // Australia

String apikey       = "your API key";            // Use your own API key by signing up for a free developer account at https://openweathermap.org/
String country      = "GB";     //your country"; //e.g. "UK";
String city         = "LONDON"; //"your city";   //e.g. "LONDON";
const char* host    = "api.openweathermap.org";

const char* ssid     = "your SSID";
const char* password = "your password";

unsigned long        lastConnectionTime = 0;          // Last time you connected to the server, in milliseconds
const unsigned long  postingInterval = 30L*60L*1000L; // Delay between updates, in milliseconds, WU allows 500 requests per-day maximum, this sets it to every 30-mins or 48/day
String Date_str, Time_str, Weekday_str;
String currCondString;  // strings to hold received API weather data and current time
String coord_lat, coord_lon;
String temp;
String humidity;
String wind;
String pressure, last_pressure, pressure_trend;
String weather_icon;
String weather_description;
String DewPointC;
String visibility;
String wind_dir, wind_speed;
String rain;

SH1106Wire display(0x3c, 5,4); // OLED display object definition (address, SDA, SCL)
OLEDDisplayUi ui  ( &display );

WiFiClient client; // wifi client object

void msOverlay(OLEDDisplay *display, OLEDDisplayUiState* state) {
  struct tm timeinfo;
  if(!getLocalTime(&timeinfo)){
    Serial.println("Failed to obtain time");
    return;
  }
  //See http://www.cplusplus.com/reference/ctime/strftime/
  display->setTextAlignment(TEXT_ALIGN_CENTER); // The coordinates define the center of the screen!
  display->drawString(64,0, Weekday_str);
  display->drawString(18,53, Date_str);
  display->drawString(107,53, Time_str);
  display->drawLine(0, 12, display_width - 1, 12);
}

void drawFrame1(OLEDDisplay *display, OLEDDisplayUiState* state, int16_t x, int16_t y) {
  struct tm timeinfo;
  if(!getLocalTime(&timeinfo)){
    Serial.println("Failed to obtain time");
    return;
  }
  //See http://www.cplusplus.com/reference/ctime/strftime/
  display->setTextAlignment(TEXT_ALIGN_CENTER); // The coordinates define the center of the screen!
  display->drawString(x+64,y+25, Date_str);
  display->drawString(x+64,y+35, Time_str);
  display->setFont(ArialMT_Plain_10);
}

void drawFrame2(OLEDDisplay *display, OLEDDisplayUiState* state, int16_t x, int16_t y) {
  display->setFont(ArialMT_Plain_10);
  String icon = getWeatherIcon();
  // The icons are drawn within a 40x20 box, each position can be slighly diiferent depending on icon shape
  if (icon == "01d" || "01n") display->drawXbm(x+0,y+20, icon_width, icon_height, sunny_icon);
  if (icon == "02d" || "02n") display->drawXbm(x+0,y+20, icon_width, icon_height, mostlysunny_icon);
  if (icon == "03d" || "03n") display->drawXbm(x+0,y+20, icon_width, icon_height, cloudy_icon);
  if (icon == "04d" || "04n") display->drawXbm(x+0,y+20, icon_width, icon_height, cloudy_icon);
  if (icon == "09d" || "09n") display->drawXbm(x+0,y+20, icon_width, icon_height, rain_icon);
  if (icon == "10d" || "10n") display->drawXbm(x+0,y+20, icon_width, icon_height, rain_icon);
  if (icon == "11d" || "11n") display->drawXbm(x+0,y+20, icon_width, icon_height, tstorms_icon);
  if (icon == "13d" || "13n") display->drawXbm(x+0,y+20, icon_width, icon_height, snow_icon);
  if (icon == "50d" || "50n") display->drawXbm(x+0,y+20, icon_width, icon_height, fog_icon);
  //display->drawRect(0,23,40,33); // Icon alignment rectangle
  display->setTextAlignment(TEXT_ALIGN_RIGHT);
  display->drawString(x+128,y+12,"At: " + Date_str + " "+ Time_str); 
  display->drawString(x+128,y+24, getCurrentWeather());
  display->drawString(x+128,y+36, getCurrC() + "°C / " + getRelHum()); // use getCurrF for fahrenheit
}

void drawFrame3(OLEDDisplay *display, OLEDDisplayUiState* state, int16_t x, int16_t y) {
  display->drawString(x+64,y+12, getWindDir()+" @ " + getWindMPH()+"mph");
  display->drawString(x+64,y+24, getPressure()+"mB [" + display_Ptrend(getPressure_trend()) + "]"); // '-' for falling '0' for no change and '+' for rising
  display->drawString(x+64,y+36, getDewPointC() + "°C Dewpoint");
}

String display_Ptrend(String indicator){
  if (indicator == "+")return "Rising";
   else if (indicator == "-") return "Falling";
     else return "Steady";
}

void drawFrame4(OLEDDisplay *display, OLEDDisplayUiState* state, int16_t x, int16_t y) {
  display->drawString(x+64,y+15,"Visibility: " + getVisibility_mi() + " miles");
  display->drawString(x+64,y+30, getPrecipTodayString() + " Rain");
}

// This array keeps function pointers to all frames frames are the single views that slide in
FrameCallback frames[] = { drawFrame1, drawFrame2, drawFrame3, drawFrame4 };

// how many frames are there?
int frameCount = 4;

// Overlays are statically drawn on top of a frame eg. a clock
OverlayCallback overlays[] = { msOverlay };
int overlaysCount = 1;

void setup() { 
  Serial.begin(115200);
  delay(1000);
  // The ESP is capable of rendering 60fps in 80Mhz mode but that won't give you much time for anything else run it in 160Mhz mode or just set it to 30 fps
  ui.setTargetFPS(30);
  // Customize the active and inactive symbol
  //  ui.setActiveSymbol(activeSymbol);
  //  ui.setInactiveSymbol(inactiveSymbol);
  // You can change this to TOP, LEFT, BOTTOM, RIGHT
  ui.setIndicatorPosition(BOTTOM);
  // Defines where the first frame is located in the bar.
  ui.setIndicatorDirection(LEFT_RIGHT);
  // You can change the transition that is used SLIDE_LEFT, SLIDE_RIGHT, SLIDE_UP, SLIDE_DOWN
  ui.setFrameAnimation(SLIDE_LEFT);
  // Add frames
  ui.setFrames(frames, frameCount);
  // Add overlays
  ui.setOverlays(overlays, overlaysCount);
  // Initialising the UI will init the display too.
  ui.init();
  display.flipScreenVertically();
  Start_WiFi(ssid,password);
  SetupTime();
  lastConnectionTime = millis();
  Call_API(currCondString);      // Get data with an API call and place response in a String
}
 
void loop() {
  int remainingTimeBudget = ui.update();
  if (remainingTimeBudget > 0) {
    // You can do some work here
    // Don't do stuff if you are below your
    // time budget.
    UpdateLocalTime();
    if (millis() - lastConnectionTime > postingInterval) {
      Call_API(currCondString);       // Get data with an API call and place response in a String
      Serial.println(currCondString); // Display the response
      lastConnectionTime = millis();
    }
    delay(remainingTimeBudget);
  }
}
 
int Start_WiFi(const char* ssid, const char* password){
 int connAttempts = 0;
 Serial.println("\r\nConnecting to: "+String(ssid));
 WiFi.begin(ssid, password);
 while (WiFi.status() != WL_CONNECTED ) {
   delay(500);
   Serial.print(".");
   if(connAttempts > 20) return -5;
   connAttempts++;
 }
 Serial.println("WiFi connected\r\n");
 Serial.print("IP address: ");
 Serial.println(WiFi.localIP());
 return 1;
}

void SetupTime() {
  configTime(gmtOffset_sec, daylightOffset_sec, "time.nist.gov");   //(gmtOffset_sec, daylightOffset_sec, ntpServer)
  setenv("TZ", Timezone, 1);  //setenv()adds the "TZ" variable to the environment with a value TimeZone, only used if set to 1, 0 means no change
  tzset(); // Set the TZ environment variable
  delay(100);
  UpdateLocalTime();
}

void UpdateLocalTime() {
  struct tm timeinfo;
  char   time_output[30], day_output[30], weekday_output[30];
  while (!getLocalTime(&timeinfo, 10000)) { // Wait for 10-sec for time to synchronise
    Serial.println("Failed to obtain time");
  }
  //See http://www.cplusplus.com/reference/ctime/strftime/
  //Serial.println(&timeinfo, "%d/%m/%y");      // Displays: 01/05/24
  strftime(day_output, sizeof(day_output), "%d/%m/%y", &timeinfo);  // Creates: '14:05:49'
  strftime(time_output, sizeof(time_output), "%H:%M:%S", &timeinfo);  // Creates: '14:05:49'
  strftime(weekday_output, sizeof(weekday_output), "%A", &timeinfo);  // Creates: 'Wednesday'
  Date_str = day_output;
  Time_str = time_output;
  Weekday_str = weekday_output;
  Serial.println(Date_str + " " + Time_str + " " + Weekday_str);
}
 
int Call_API(String &resultString) {
  client.stop();  // Clear any current connections
  Serial.println("Connecting to "+String(host)); // start a new connection
  const int httpPort = 80;
  if (!client.connect(host, httpPort)) {
   Serial.println("Connection failed");
   return false;
  }
  //http://api.openweathermap.org/data/2.5/weather?q=London,UK&APPID=8f0e2239c68a60e29f69c488042d247a&mode=json&units=metric&cnt=1
  String url = "http://api.openweathermap.org/data/2.5/weather?q=London,UK&APPID=" + apikey + "&mode=json&units=metric";
  Serial.println("Requesting URL: "+String(url));
  client.print(String("GET ") + url + " HTTP/1.1\r\n" +
  "Host: " + host + "\r\n" +
  "Connection: close\r\n\r\n");
  unsigned long timeout = millis();
  while (client.available() == 0) {
    if (millis() - timeout > 5000) {
      Serial.println(">>> Client Connection Timeout...Stopping");
      client.stop();
      return false;
    }
  }
  Serial.print("Receiving API weather data");
  while(client.available()) {
    resultString = client.readStringUntil('\r');
    Serial.print(".");
  }
  Serial.println(resultString);
  Serial.println("\r\nClosing connection");
  Decode_Response(resultString);
  return true;
}

bool Decode_Response(String input){
  JsonDocument doc;
  DeserializationError error = deserializeJson(doc, input);
  if (error) {
    Serial.print("deserializeJson() failed: ");
    Serial.println(error.c_str());
    return false;
  }
  float lon = doc["coord"]["lon"];
  float lat = doc["coord"]["lat"];
  coord_lon = String(lon, 1);
  coord_lat = String(lat, 1);
  
  JsonObject weather_0 = doc["weather"][0];
  int weather_0_id = weather_0["id"]; // 804
  const char* weather_0_main = weather_0["main"]; // "Clouds"
  const char* wx_desc = weather_0["description"];
  weather_description = String(wx_desc); // "overcast clouds"
  const char* Icon = weather_0["icon"];
  weather_icon = String(Icon); // "04d"
  const char* base = doc["base"]; // "stations"
  JsonObject main = doc["main"];
  float Temp = main["temp"];
  temp = String(Temp, 1); // 15.54
  float main_feels_like = main["feels_like"]; // 14.87
  float main_temp_min = main["temp_min"]; // 13.5
  float main_temp_max = main["temp_max"]; // 17.27
  last_pressure = pressure;
  int Pres = main["pressure"];
  pressure = String(Pres); // 1008
  pressure_trend = "0";
  if (pressure.toFloat() - last_pressure.toFloat() > 0.05) pressure_trend = "+";
  if (pressure.toFloat() - last_pressure.toFloat() < 0.05) pressure_trend = "-";
  int Humi = main["humidity"];
  humidity = String(Humi); // 66
  int main_sea_level = main["sea_level"]; // 1008
  int main_grnd_level = main["grnd_level"]; // 995
  int Visi = doc["visibility"];
  visibility = String(Visi); // 10000
  float Rain = doc["rain"]["1h"];
  rain = String(Rain, 1); // 3.16
  JsonObject wind = doc["wind"];
  float WindSp = wind["speed"];
  wind_speed = String(WindSp, 1); // 3.66
  int wind_deg = wind["deg"]; // 306
  float wind_gust = wind["gust"]; // 3.65

  int clouds_all = doc["clouds"]["all"]; // 100
  long dt = doc["dt"]; // 1714573227
  JsonObject sys = doc["sys"];
  int sys_type = sys["type"]; // 2
  long sys_id = sys["id"]; // 2072720
  const char* sys_country = sys["country"]; // "GB"
  long sys_sunrise = sys["sunrise"]; // 1714538404
  long sys_sunset = sys["sunset"]; // 1714591860
  int timezone = doc["timezone"]; // 3600
  long id = doc["id"]; // 2642786
  const char* name = doc["name"]; // "Melksham"
  int cod = doc["cod"]; // 200
  return true;
}

// Functions for weather data.
String getCountry()           { return country; }
String getCity()              { return city; }
String getLatitude()          { return coord_lat; }
String getLongitude()         { return coord_lon; }
String getCurrC()             { return temp; }
String getRelHum()            { return humidity; }
String getWindString()        { return wind; }
String getPressure_mb()       { return pressure; }
String getWeatherIcon()       { return weather_icon; }
String getCurrentWeather()    { return weather_description; }
String getDewPointC()         { return DewPointC; }
String getVisibility_mi()     { return visibility; }
String getWindDir()           { return wind_dir; }
String getWindMPH()           { return wind_speed + "mph"; }
String getPressure()          { return pressure; }
String getPressure_trend()    { return pressure_trend; }
String getPrecipTodayString() { return rain; }

/* Typical API response:
{
    "coord": {
        "lon": -2.14,
        "lat": 51.3728
    },
    "weather": [
        {
            "id": 804,
            "main": "Clouds",
            "description": "overcast clouds",
            "icon": "04d"
        }
    ],
    "base": "stations",
    "main": {
        "temp": 15.54,
        "feels_like": 14.87,
        "temp_min": 13.5,
        "temp_max": 17.27,
        "pressure": 1008,
        "humidity": 66,
        "sea_level": 1008,
        "grnd_level": 995
    },
    "visibility": 10000,
    "wind": {
        "speed": 3.66,
        "deg": 306,
        "gust": 3.65
    },
    "clouds": {
        "all": 100
    },
    "dt": 1714573227,
    "sys": {
        "type": 2,
        "id": 2072720,
        "country": "GB",
        "sunrise": 1714538404,
        "sunset": 1714591860
    },
    "timezone": 3600,
    "id": 2642786,
    "name": "Melksham",
    "cod": 200
}
*/
